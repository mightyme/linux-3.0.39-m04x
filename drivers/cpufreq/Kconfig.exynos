## drivers/cpufreq/Kconfig.exynos
```kconfig
config EXYNOS_CPUFREQ
	bool "SAMSUNG EXYNOS 4210/4X12 CPU Frequency driver"
	default y
	help
	 EXYNOS4 CPU Frequency driver.

if EXYNOS_CPUFREQ

config EXYNOS4210_CPUFREQ
	bool "Exynos 4210 cpufreq support"
	depends on CPU_EXYNOS4210
	help
	  Exynos4210 cpufreq support

config EXYNOS4X12_CPUFREQ
	bool "Exynos 4212/4412 cpufreq support"
	depends on CPU_EXYNOS4212
	help
	  Exynos4412/4212 cpufreq support

choice 
	prompt "EXYNOS4210 Max CPU Frequency"
	depends on EXYNOS4210_CPUFREQ
	default EXYNOS4210_1400MHZ_SUPPORT

config EXYNOS4210_1400MHZ_SUPPORT
	bool "Max 1400MHz CPUFREQ LEVEL"

config EXYNOS4210_1200MHZ_SUPPORT
        bool "Max 1200MHz CPUFREQ LEVEL"

endchoice

choice
	prompt "EXYNOS4212 Max CPU frequency"
	depends on EXYNOS4X12_CPUFREQ
	default EXYNOS4212_1500MHZ_SUPPORT

config EXYNOS4212_1500MHZ_SUPPORT
	bool "Max 1500MHz CPUFREQ LEVEL"
	help
	  Max 1.5Ghz support

config EXYNOS4212_1400MHZ_SUPPORT
	bool "Max 1400MHz CPUFREQ LEVEL"
	help
	  Max 1.4Ghz support

endchoice

choice
	prompt "EXYNOS4412 Max CPU frequency"
	depends on EXYNOS4X12_CPUFREQ
	default EXYNOS4412_1400MHZ_SUPPORT

config EXYNOS4412_1500MHZ_SUPPORT
	bool "Max 1500MHz CPUFREQ LEVEL"
	depends on !CPU_EXYNOS4412
	help
	  Max 1.5Ghz support

config EXYNOS4412_1400MHZ_SUPPORT
	bool "Max 1400MHz CPUFREQ LEVEL"
	help
	  Max 1.4Ghz support

config EXYNOS4412_1200MHZ_SUPPORT
	bool "Max 1200MHz CPUFREQ LEVEL"
	help
	  Max 1.2Ghz support
endchoice

endif
```

## drivers/modem/Kconfig
```kconfig
menuconfig MEIZU_MODEM
	bool "Meizu Mobile Modem Interface"
	default n
	---help---
	  Samsung Modem Interface Driver.

config UMTS_MODEM_XMM6160
	bool "modem chip : IFX XMM6160"
	depends on MEIZU_MODEM
	default n

config UMTS_MODEM_XMM6260
	bool "modem chip : IFX XMM6260"
	depends on MEIZU_MODEM
	default n

config UMTS_MODEM_XMM6262
	bool "modem chip : IFX XMM6262"
	depends on MEIZU_MODEM
	default n

config LINK_DEVICE_HSIC
	bool "modem driver link device HSIC"
	depends on MEIZU_MODEM
	depends on ! MX_RECOVERY_KERNEL
	default n

#config SIM_DETECT
	#bool "SIM_DETECT pin"
	#depends on MEIZU_MODEM
	#default n
```
